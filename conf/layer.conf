## conf/layer.conf
```bitbake
# We have a conf and classes directory, add to BBPATH
BBPATH .= ":${LAYERDIR}"

# We have recipes-* directories, add to BBFILES
BBFILES += "${LAYERDIR}/recipes-*/*/*.bb \
            ${LAYERDIR}/recipes-*/*/*.bbappend"

BBFILE_COLLECTIONS += "meta-esper"
BBFILE_PATTERN_meta-esper = "^${LAYERDIR}/"
BBFILE_PRIORITY_meta-esper = "6"

LAYERDEPENDS_meta-esper = "core"
LAYERSERIES_COMPAT_meta-esper = "scarthgap"
```
